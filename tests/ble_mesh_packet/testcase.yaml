## tests/ble_mesh_packet/testcase.yaml
```yaml
tests:
  hybrid_mesh.ble_mesh_packet:
    platform_allow:
      - native_sim
    integration_platforms:
      - native_sim
    tags:
      - bluetooth
      - mesh
```

## tests/hybrid_router/testcase.yaml
```yaml
tests:
  hybrid_mesh.hybrid_router:
    platform_allow:
      - native_sim
      - xiao_ble/nrf52840
    integration_platforms:
      - native_sim
    tags:
      - router
      - mesh
```

## tests/lora_transport/testcase.yaml
```yaml
tests:
  hybrid_mesh.lora_transport:
    platform_allow:
      - native_sim
    integration_platforms:
      - native_sim
    tags:
      - lora
      - mesh
```

## tests/uk_lora_one_shot/testcase.yaml
```yaml
tests:
  hybrid_mesh.uk_lora_one_shot.locked:
    platform_allow:
      - qemu_cortex_m3
    integration_platforms:
      - qemu_cortex_m3
    tags:
      - lora
      - regulatory
  hybrid_mesh.uk_lora_one_shot.allow_hostonly:
    platform_allow:
      - qemu_cortex_m3
    extra_args: ONE_SHOT_TEST_ALLOW=ON
    tags:
      - lora
      - regulatory
```

## tests/uk_lora_regulatory/testcase.yaml
```yaml
tests:
  hybrid_mesh.uk_lora_regulatory:
    platform_allow:
      - native_sim
      - qemu_cortex_m3
    integration_platforms:
      - qemu_cortex_m3
    tags:
      - lora
      - regulatory
```
