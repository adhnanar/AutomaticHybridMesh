#include <zephyr/dt-bindings/gpio/gpio.h>

&i2c1 {
	status = "disabled";
};

&xiao_spi {
	status = "okay";
	cs-gpios = <&gpio0 4 GPIO_ACTIVE_LOW>;

	sx1262: sx1262@0 {
		compatible = "semtech,sx1262";
		reg = <0>;
		spi-max-frequency = <1000000>;
		reset-gpios = <&gpio0 28 GPIO_ACTIVE_LOW>;
		busy-gpios = <&gpio0 29 GPIO_ACTIVE_HIGH>;
		dio1-gpios = <&gpio0 3 GPIO_ACTIVE_HIGH>;
		status = "okay";
	};
};
